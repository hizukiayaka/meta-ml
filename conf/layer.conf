## conf/layer.conf
```bitbake
# Copyright (C) 2018 SUMOMO Computer Assocation
# Released under the MIT license (see COPYING.MIT for the terms)

# We have a conf and classes directory, add to BBPATH
BBPATH .= ":${LAYERDIR}"

# We have recipes-* directories, add to BBFILES
BBFILES += "${LAYERDIR}/recipes-*/*/*.bb ${LAYERDIR}/recipes-*/*/*.bbappend"

BBFILE_COLLECTIONS += "gacceleration"
BBFILE_PATTERN_gacceleration = "^${LAYERDIR}/"
BBFILE_PRIORITY_gacceleration = "2"

# This should only be incremented on significant changes that will
# cause compatibility issues with other layers
LAYERVERSION_gacceleration = "1"

LAYERDEPENDS_ML = "core"
```
